## firmware/esp32-s3-link/main/Kconfig.projbuild
```kconfig
menu "RX3 Link bridge"

    config RX3_LINK_WIFI_SSID
        string "Wi-Fi SSID"
        default ""
        help
            Configure this in sdkconfig.local.defaults. The bridge does not
            start when the SSID is empty.

    config RX3_LINK_WIFI_PASSWORD
        string "Wi-Fi password"
        default ""

    config RX3_LINK_WIFI_MAC
        string "Optional station MAC override"
        default ""
        help
            Leave empty to use the stable factory Wi-Fi station MAC. A custom
            value must be a locally administered unicast address such as
            02:52:58:33:00:01. USB NCM uses this same address.

    config RX3_LINK_STATS_INTERVAL_SECONDS
        int "Statistics log interval in seconds"
        range 1 3600
        default 10

    config RX3_LINK_WIFI_TO_USB_QUEUE_DEPTH
        int "Wi-Fi-to-USB frame queue depth"
        range 4 32
        default 16
        help
            Bounds frames waiting for USB without blocking the Wi-Fi receive
            task when the host disables or re-enumerates the NCM interface.

endmenu
```

## firmware/esp32-s3-link/sdkconfig.defaults
```kconfig
CONFIG_IDF_TARGET="esp32s3"
CONFIG_ESPTOOLPY_FLASHSIZE_8MB=y
CONFIG_ESP_DEFAULT_CPU_FREQ_MHZ_240=y
CONFIG_PARTITION_TABLE_CUSTOM=y
CONFIG_PARTITION_TABLE_CUSTOM_FILENAME="partitions.csv"
CONFIG_TINYUSB_NET_MODE_NCM=y
CONFIG_TINYUSB_MSC_ENABLED=y
CONFIG_TINYUSB_MSC_BUFSIZE=4096
CONFIG_TINYUSB_DESC_MSC_STRING="RX3 Bootstrap Disk"
CONFIG_TINYUSB_DESC_USE_ESPRESSIF_VID=y
CONFIG_TINYUSB_DESC_USE_DEFAULT_PID=n
CONFIG_TINYUSB_DESC_CUSTOM_PID=0x4012
CONFIG_TINYUSB_DESC_MANUFACTURER_STRING="RX3 Toolkit"
CONFIG_TINYUSB_DESC_PRODUCT_STRING="RX3 Wi-Fi Link Bridge"
CONFIG_TINYUSB_DESC_SERIAL_STRING="RX3LINK-S3-0001"
CONFIG_TINYUSB_NCM_OUT_NTB_BUFFS_COUNT=6
CONFIG_TINYUSB_NCM_IN_NTB_BUFFS_COUNT=6
CONFIG_TINYUSB_NCM_OUT_NTB_BUFF_MAX_SIZE=6400
CONFIG_TINYUSB_NCM_IN_NTB_BUFF_MAX_SIZE=6400
CONFIG_ESP_WIFI_DYNAMIC_RX_BUFFER_NUM=32
CONFIG_ESP_WIFI_DYNAMIC_TX_BUFFER_NUM=32
CONFIG_ESP_WIFI_RX_BA_WIN=6
CONFIG_RX3_LINK_WIFI_TO_USB_QUEUE_DEPTH=16
CONFIG_LOG_DEFAULT_LEVEL_INFO=y
CONFIG_ESP_CONSOLE_UART_DEFAULT=y
CONFIG_ESP_CONSOLE_UART_NUM=0
CONFIG_ESP_CONSOLE_SECONDARY_NONE=y
```
